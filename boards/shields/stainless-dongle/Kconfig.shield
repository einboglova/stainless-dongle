## boards/shields/stainless-dongle/Kconfig.shield
```kconfig
# No whitespace after the comma or in the keyboard name!
config HELIX_STAINLESS_DONGLE
    def_bool $(shields_list_contains,stainless_dongle)
```

## boards/shields/stainless_dongle/Kconfig.shield
```kconfig
# No whitespace after the comma or in the keyboard name!
config SHIELD_STAINLESS_DONGLE_DONGLE
    def_bool $(shields_list_contains,stainless_dongle)
```
